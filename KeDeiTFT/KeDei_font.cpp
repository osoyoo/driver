/*
welcome use KeDeiTFT
*/
#include "KeDei_font.h"


//Word stock


static unsigned char font16_B[95][16]={
			{0x00,0x00,0x00,0x00,0x00,0x00,0x00,0x00,0x00,0x00,0x00,0x00,0x00,0x00,0x00,0x00},/*" ",0*/
			{0x00,0x00,0x00,0x18,0x18,0x18,0x18,0x18,0x18,0x18,0x00,0x00,0x38,0x38,0x00,0x00},/*"!",1*/
			{0x00,0xD8,0xFC,0x6C,0x36,0x00,0x00,0x00,0x00,0x00,0x00,0x00,0x00,0x00,0x00,0x00},/*""",2*/
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			{0x1C,0x76,0xC6,0x00,0x00,0x00,0x00,0x00,0x00,0x00,0x00,0x00,0x00,0x00,0x00,0x00},/*"~",94*/
		};


/*****************************************
 *The function name ： begin
 *Function  ： 初始化类中的成员变量
 *Input  ： none
 *Output   ： none
 *Author   ：KeDei
 *Time   ：2015/4/21
 ****************************************/
void Font::begin(void)
{
		
		font_color		= 0xf800;
		font_size		= 16;
		txt_x0			= 0;
		txt_y0			= 0;
		txt_x1			= 240;
		txt_y1			= 320;

		now_x			= txt_x0;
		now_y			= txt_y0;
		char_m			= 0;
		char_n			= 0;
}

/*****************************************
 *The function name ： set_txt
 *Function  ： 设置文本区域，文本区域的左上坐标(x0,y0),右下坐标(x1,y1)，
			文本的颜色为txt_b_color；
			若txt_b_color为NULL 则不显示颜色，0x0000也一样的 ^.^
 *Input  ： none
 *Output   ： none
 *Author   ：KeDei
 *Time   ：2015/4/21
 ****************************************/
void Font::set_txt(unsigned short x0,unsigned short y0,unsigned short x1,unsigned short y1,unsigned short txt_b_color)
{
	txt_x0			= x0;
	txt_y0			= y0;
	txt_x1			= x1;
	txt_y1			= y1;
	now_x			= x0;
	now_y			= y0;
	txt_backcolor	= txt_b_color;
	//if(txt_b_color != NULL)
		TFT.draw_area(x0,y0,x1,y1,txt_b_color);
	
}

/*****************************************
 *The function name ： set_fontcolor
 *Function  ： 设置字体的颜色为f_color
 *Input  ： f_color
 *Output   ： none
 *Author   ：KeDei
 *Time   ：2015/4/21
 ****************************************/
void Font::set_fontcolor(unsigned short f_color)
{
	font_color	= f_color;
}


/*****************************************
 *The function name ： clear_txt
 *Function  ： 清楚当前的文本内容
 *Input  ： color  （no used）
 *Output   ： none
 *Author   ：KeDei
 *Time   ：2015/4/21
 ****************************************/
void Font::clear_txt(unsigned short color)
{
	TFT.draw_area(txt_x0,txt_y0,txt_x1,txt_y1,txt_backcolor);
}


/*****************************************
 *The function name ： lcd_char
 *Function  ： 显示字符
 *Input  ： data
 *Output   ： none
 *Author   ： KeDei
 *Time   ： 2015/4/21
 ****************************************/
void Font::lcd_char(char _data)
{

	if(now_x > txt_x1-(font_size/2)) 
	{
		now_x =  txt_x0;
		now_y += 16;
	}
	if(now_y > txt_y1-16)
	{
		now_y = txt_y0;
		clear_txt(txt_backcolor);
	}

	char_i=(int)_data-32;

//Serial.println(char_i);
	for(char_m = 0;char_m < 16;char_m++)
	{

		for(char_n = 0; char_n < 8;char_n++)
		{

		   if(font16_B[char_i][char_m]&1<<char_n)
			{
			   TFT.set_area(now_x,now_y,++now_x,now_y);
			   TFT.w_data(font_color>>8);
			   TFT.w_data(font_color);
			}
			else
			{
			  now_x++;
  
			}
		 }
		 now_y++;
		 now_x-=8;
	}
	now_y-=16;
	now_x+= 8+font_interval;
}

/*****************************************
 *The function name ： lcd_string
 *Function  ： 显示字符串
 *Input  ： *str
 *Output   ： none
 *Author   ： KeDei
 *Time   ： 2015/4/21
 ****************************************/
void Font::lcd_string(char str[])
{
  char *str_char=str;
  for(;;)
  {
      if(*str_char == '\0')
      {
          now_y+=16;
          now_x = txt_x0;
          return;
      }
      if(*str_char == '\n')
      {
          now_y+=16;
          now_x = txt_x0;
          str_char++ ;
      }
      lcd_char(*str_char++);
  }
}

/*****************************************
 *The function name ： lcd_int
 *Function  ： 显示整型变量值
 *Input  ： *int value
 *Output   ： none
 *Author   ： KeDei
 *Time   ： 2015/4/21
 ****************************************/
void	Font::lcd_int(int value)
{
	itoa(value,buff,10); 
	lcd_string(buff);
}